## config/west.yml
```yaml
manifest:
  remotes:
    - name: zmkfirmware
      url-base: https://github.com/zmkfirmware
  projects:
    - name: zmk
      remote: zmkfirmware
      # Pinned to v0.2.1 for compatibility with seeeduino_xiao_ble board name
      # v0.3.0+ renamed boards to use //zmk suffix
      revision: v0.2.1
      import: app/west.yml
  self:
    path: config
```
